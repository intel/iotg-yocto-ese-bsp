## conf/layer.conf
```bitbake
# We have a conf and classes directory, add to BBPATH
BBPATH .= ":${LAYERDIR}"

# We have recipes-* directories, add to BBFILES
BBFILES += "${LAYERDIR}/backports/${LAYERSERIES_COMPAT_core}/recipes-*/*/*.bb"
BBFILES += "${LAYERDIR}/backports/${LAYERSERIES_COMPAT_core}/recipes-*/*/*.bbappend"
BBFILES += "${LAYERDIR}/recipes-*/*/*.bb ${LAYERDIR}/recipes-*/*/*.bbappend"

BBFILE_COLLECTIONS += "intel-ese-bsp"
BBFILE_PATTERN_intel-ese-bsp = "^${LAYERDIR}/"
BBFILE_PRIORITY_intel-ese-bsp = "8"

# This should only be incremented on significant changes that will
# cause compatibility issues with other layers
#LAYERVERSION_intel-ese-main = "1"

LAYERDEPENDS_intel-ese-bsp = "core intel"
LAYERSERIES_COMPAT_intel-ese-bsp = "kirkstone"

KERNEL_CLASSES:append:x86-64 = " kernel-fixes kernel-decoupler kernel-source-deploy"
IMAGE_CLASSES:append:linux = " multi-kernel-fix"
INHERIT += "${@bb.utils.contains('IMAGE_FEATURES', 'slimboot', 'slimboot-complementary-glob', '', d)}"

#### out of tree module support for alternate kernels
# https://bugzilla.yoctoproject.org/show_bug.cgi?id=13226
INHERIT += "kernel-module-inheritor"
KERNEL_CLASSES:append = " kernel-oot-mod-scripts"
MODULE_CLASSES:append = " kernel-oot-base"
# TODO: strip and then sign to reduce installation size
MODULE_CLASSES:append = "${@bb.utils.contains('DISTRO_FEATURES', 'kernel-compress-modules', ' kernel-compress-modules', '', d)}"
# switch on/off wifi depending on KERNEL_PROVIDERS tag declaration
INHERIT += "kernel-wifi-conf"

LAYERDIR-ese-bsp := "${LAYERDIR}"
```
